## drivers/input/fingerprint/Kconfig
```kconfig
#
# Fingerprint driver configuration
#
menuconfig INPUT_FINGERPRINT
	bool "Fingerprints"
	default y
	help
	  Say Y here, and a list of supported fingerprints will be displayed.
	  This option doesn't affect the kernel.

	  If unsure, say Y.

if INPUT_FINGERPRINT

source "drivers/input/fingerprint/ets_fps_mmi/Kconfig"
source "drivers/input/fingerprint/fpc_fps_mmi/Kconfig"

endif
```

## drivers/input/fingerprint/ets_fps_mmi/Kconfig
```kconfig
config FINGERPRINT_EGISTEC_FPS_MMI
	tristate "Egistec FPS fingerprint sensor"
	depends on INPUT_FINGERPRINT
	default n
	help
	 Say Y here if you wish to include support for EGIS finger print sensor.
	 If unsure, say N.

config INPUT_EGISTEC_FPS_NAVI
	bool "Egistec fingerprint horizontal navigation"
	depends on FINGERPRINT_EGISTEC_FPS_MMI
	default y
	help
	 Say Y here if you wish to include navigation support for EGIS finger print sensor.
	 If unsure, say Y.

config INPUT_EGISTEC_FPS_NAVI_HORIZON
	bool "Egistec fingerprint horizontal navigation"
	depends on INPUT_EGISTEC_FPS_NAVI
	default y
	help
	 Say Y here if you wish to include horizontal navigation support for EGIS finger print sensor.
	 If unsure, say Y.

config INPUT_EGISTEC_FPS_NAVI_VERTICAL
	bool "Egistec fingerprint vertical navigation"
	depends on INPUT_EGISTEC_FPS_NAVI
	default y
	help
	 Say Y here if you wish to include vertical navigation support for EGIS finger print sensor.
	 If unsure, say Y.

config NAV_DOUBLE_TAP
	bool "Egistec fingerprint display double tap"
	depends on FINGERPRINT_EGISTEC_FPS_MMI
	default y
	help
	 Say Y here if you wish to include double tap support for EGIS finger print sensor.
	 If unsure, say Y.

config DISPLAY_SPEED_UP
	bool "Egistec fingerprint display speed up"
	depends on FINGERPRINT_EGISTEC_FPS_MMI
	default n
	help
	 Say Y here if you wish to include display speed up support for EGIS finger print sensor.
	 If unsure, say N.
```

## drivers/input/fingerprint/fpc_fps_mmi/Kconfig
```kconfig
config FINGERPRINT_FPC_TEE_MMI
	tristate "Finger print card fpc"
	depends on INPUT_FINGERPRINT
	default n
	help
	  Say Y here to enable support for retrieving self-test reports.

	  If unsure, say N.

	  To compile this driver as a module, choose M here.

config INPUT_MISC_FPC1020_SAVE_TO_CLASS_DEVICE
	bool "BOARD_HAS_MULTI_FPS"
	depends on FINGERPRINT_FPC_TEE_MMI
	default y
	help
	  Say Y here to enable support for multiple fps.
```

## drivers/input/touchscreen/focaltech_0flash_mmi/Kconfig
```kconfig
#
# Focaltech Touchscreen driver configuration
#

config TOUCHSCREEN_FTS_0FLASH_MMI
	tristate "Moto Focaltech Touchscreen"
	depends on I2C
	default n
	help
	  Say Y here if you have Moto Focaltech touch panel.
	  If unsure, say N.

config INPUT_FOCALTECH_0FLASH_MMI_IC_NAME_FT8719
	bool "Focaltech Chip FT8719"
	depends on TOUCHSCREEN_FTS_0FLASH_MMI
	default n
	help
	  Say Y here to enable support for Focaltech FT8719 touch panel.
	  If unsure, say N.

config INPUT_FOCALTECH_0FLASH_MMI_IC_NAME_FT8756
	bool "Focaltech Chip FT8756"
	depends on TOUCHSCREEN_FTS_0FLASH_MMI
	default n
	help
	  Say Y here to enable support for Focaltech FT8756 touch panel.
	  If unsure, say N.

config INPUT_FOCALTECH_0FLASH_MMI_IC_NAME_FT8009
	bool "Focaltech Chip FT8009"
	depends on TOUCHSCREEN_FTS_0FLASH_MMI
	default n
	help
	  Say Y here to enable support for Focaltech FT8009 touch panel.
	  If unsure, say N.

config TOUCHSCREEN_FTS_0FLASH_MMI_ENABLE_DOUBLE_TAP
	bool "Moto Focaltech Double tap"
	depends on TOUCHSCREEN_FTS_0FLASH_MMI
	default n
	help
	  Say Y here to enable support for double tap functionality on Focaltech touch panel.
	  If unsure, say N.

config TOUCHSCREEN_FTS_0FLASH_MMI_ENABLE_PALM
	bool "Moto Focaltech Palm"
	depends on TOUCHSCREEN_FTS_0FLASH_MMI
	default n
	help
	  Say Y here to enable support for Palm functionality on Focaltech touch panel.
	  If unsure, say N.

config INPUT_FOCALTECH_0FLASH_MMI_PEN_NOTIFIER
	bool "Moto Focaltech Pen"
	depends on TOUCHSCREEN_FTS_0FLASH_MMI
        default n
        help
          Say Y here to enable support for Pen functionality on Focaltech touch panel.
          If unsure, say N.
```

## drivers/input/touchscreen/himax_v2_mmi/Kconfig
```kconfig
#
# Himax Touchscreen driver configuration
#

config TOUCHSCREEN_HIMAX_SPI
	tristate "HIMAX chipset SPI touchscreen"
	depends on TOUCHSCREEN_HIMAX_CHIPSET
	help
	  This enables support for HIMAX CHIPSET over SPI based touchscreens.

config TOUCHSCREEN_HIMAX_INCELL
	bool "HIMAX chipset in-cell function"
	depends on TOUCHSCREEN_HIMAX_SPI
	help
	  This enables support for HIMAX CHIPSET of in-cell function.

config TOUCHSCREEN_HIMAX_IC_HX83112
	tristate "HIMAX chipset HX83112 function"
	depends on TOUCHSCREEN_HIMAX_INCELL
	help
	  This enables support for HIMAX CHIPSET of HX83112.

config TOUCHSCREEN_HIMAX_IC_HX83112F
	tristate "HIMAX chipset HX83112F function"
	depends on TOUCHSCREEN_HIMAX_INCELL
	help
	  This enables support for HIMAX CHIPSET of HX83112F.

config TOUCHSCREEN_HIMAX_IC_HX83102
	tristate "HIMAX chipset HX83102 function"
	depends on TOUCHSCREEN_HIMAX_INCELL
	help
	  This enables support for HIMAX CHIPSET of HX83102.

config TOUCHSCREEN_HIMAX_IC_HX83102D
	tristate "HIMAX chipset HX83102D function"
	depends on TOUCHSCREEN_HIMAX_INCELL
	help
	  This enables support for HIMAX CHIPSET of HX83102D.

config TOUCHSCREEN_HIMAX_DEBUG
	bool "HIMAX debug function"
	depends on TOUCHSCREEN_HIMAX_SPI
	help
	  This enables support for HIMAX debug function.

config TOUCHSCREEN_HIMAX_INSPECT
	bool "HIMAX inspect function"
	depends on TOUCHSCREEN_HIMAX_SPI
	help
	  This enables support for HIMAX debug function.

config HMX_DB
	bool "HIMAX driver test over Dragon Board"
	depends on TOUCHSCREEN_HIMAX_SPI
	help
	  This enables support for HIMAX driver test over Dragon Board.

config TOUCHSCREEN_HIMAX_ENABLE_PALM
	bool "HIMAX palm function"
	depends on TOUCHSCREEN_HIMAX_SPI
	help
	  This enables support for HIMAX palm function.

config TOUCHSCREEN_HIMAX_ENABLE_DOUBLE_TAP
	bool "HIMAX double tap function"
	depends on TOUCHSCREEN_HIMAX_SPI
	help
	  This enables support for HIMAX double tap function.

config TOUCHSCREEN_HIMAX_ENABLE_MULTI_BIN
	bool "HIMAX multi bin function"
	depends on TOUCHSCREEN_HIMAX_SPI
	help
	  This enables support for HIMAX multi bin function.

config TOUCHSCREEN_HIMAX_PANEL_NOTIFICATIONS
	bool "HIMAX panel notification function"
	depends on TOUCHSCREEN_HIMAX_SPI
	help
	  This enables support for HIMAX notification function.
```

## drivers/input/touchscreen/nova_0flash_mmi/Kconfig
```kconfig
#
# Novatek NT36xxx touchscreen driver configuration
#
config TOUCHSCREEN_NT36xxx_HOSTDL_SPI_MMI
	tristate "Moto Novatek NT36xxx host download SPI driver"
	default n
	help
	  Say Y here if you have a Moto Novatek NT36xxx no flash touchscreen connected
	  to your system by SPI bus.

	  If unsure, say N.

config INPUT_NOVA_0FLASH_MMI_ENABLE_DOUBLE_TAP
	bool "Moto Novatek NT36xxx Double tap"
	depends on TOUCHSCREEN_NT36xxx_HOSTDL_SPI_MMI
	default n
	help
	  Say Y here if you want to have Double tap support on Moto Novatek NT36xxx.

	  If unsure, say N.

config INPUT_NOVA_PANEL_NOTIFICATIONS
	bool "Moto Novatek NT36xxx panel notification"
	depends on TOUCHSCREEN_NT36xxx_HOSTDL_SPI_MMI
	default n
	help
	  Say Y here if you want to have panel notification support on Moto Novatek NT36xxx.

	  If unsure, say N.

config NOVA_ESD_ENABLE
        bool "Moto Novatek NT36xxx ESD Detection"
        depends on TOUCHSCREEN_NT36xxx_HOSTDL_SPI_MMI
        default n
        help
          Say Y here if you want to have ESD Detection support on Moto Novatek NT36xxx.

          If unsure, say N.
```

## drivers/misc/pen/Kconfig
```kconfig
config PEN_BU520XX
	tristate "Moto Pen BU520XX driver"
	help
	  Say Y here if you have Pen
	  defined in your system.

	  If unsure, say N.

	  To compile this driver as a module, choose M here: the
	  module will be called bu520xx_pen.
```

## drivers/power/qpnp-smbcharger-mmi/Kconfig
```kconfig
config QPNP_SMBCHARGER_MMI
        tristate "QPNP SMBCHARGER MMI"
        default n
        help
         Say Y here if you have a qpnp smbcharger mmi compatible
         device connected.

         This driver can also be built as a module.  If so, the module
         will be called qpnp_smbcharger_mmi.
```
